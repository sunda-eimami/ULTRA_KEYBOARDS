## config/boards/shields/first/Kconfig.defconfig
```kconfig
if SHIELD_FIRST_LEFT

config ZMK_KEYBOARD_NAME
    default "first"

config ZMK_SPLIT_ROLE_CENTRAL
    default y

endif

if SHIELD_FIRST_LEFT || SHIELD_FIRST_RIGHT

config ZMK_SPLIT
    default y

endif
```

## zmk/config/boards/shields/first/Kconfig.shield
```kconfig
config SHIELD_FIRST_LEFT
    def_bool $(shields_list_contains,first_left)

config SHIELD_FIRST_RIGHT
    def_bool $(shields_list_contains,first_right)
```
